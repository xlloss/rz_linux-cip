// SPDX-License-Identifier: (GPL-2.0-only OR BSD-2-Clause)
/*
 * Device Tree Source for the RZ/G2L Apollo board
 *
 * Copyright (C) 2024 Regulus Corp.
 */

/dts-v1/;
#include "r9a07g044l2-apollo.dtsi"

/ {
	model = "Renesas Apollo Board hdmi";
	compatible = "renesas,apollo", "renesas,r9a07g044l2", "renesas,r9a07g044";
};

&dsi0 {
	status = "okay";
};

&panel_dsi_fake {
	status = "okay";

	panel-timing {
		clock-frequency = <49000000>;
		hactive = <1024>;
		vactive = <600>;

		hsync-len = <13>;
		hfront-porch = <5>;
		hback-porch = <270>;

		vsync-len = <3>;
		vfront-porch = <2>;
		vback-porch = <17>;

		hsync-active = <1>;
		vsync-active = <1>;
		de-active = <1>;
		pixelclk-active = <1>;
		syncclk-active = <1>;
	};
};
